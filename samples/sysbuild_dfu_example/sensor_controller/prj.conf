## CMakeLists.txt
```
#
# Copyright (c) 2024 Nordic Semiconductor ASA
#
# SPDX-License-Identifier: LicenseRef-Nordic-5-Clause
#

cmake_minimum_required(VERSION 3.20.0)

find_package(Zephyr REQUIRED HINTS $ENV{ZEPHYR_BASE})
project(sensor_controller)

target_sources(app PRIVATE src/main.c)
```

## prj.conf
```kconfig
# Sensor Controller Image Configuration

# Enable DFU support with a specific image ID
CONFIG_DFU_IMAGE_ID=20

# Enable MCUboot support
CONFIG_BOOTLOADER_MCUBOOT=y
CONFIG_MCUBOOT_IMAGE_NUMBER=20

# Basic configuration
CONFIG_MAIN_STACK_SIZE=2048
CONFIG_LOG=y
```

## src/main.c
```c
/*
 * Copyright (c) 2024 Nordic Semiconductor ASA
 *
 * SPDX-License-Identifier: LicenseRef-Nordic-5-Clause
 */

#include <zephyr/kernel.h>
#include <zephyr/logging/log.h>

LOG_MODULE_REGISTER(sensor_controller, LOG_LEVEL_INF);

int main(void)
{
	LOG_INF("Sensor Controller Image (DFU ID: 20)");
	LOG_INF("This image will be automatically detected and included in DFU packages");

	while (1) {
		LOG_INF("Sensor controller running...");
		k_sleep(K_SECONDS(5));
	}

	return 0;
}
```
