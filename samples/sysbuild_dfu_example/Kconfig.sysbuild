## samples/sysbuild_dfu_example/Kconfig.sysbuild
```kconfig
#
# Copyright (c) 2024 Nordic Semiconductor ASA
#
# SPDX-License-Identifier: LicenseRef-Nordic-5-Clause
#

config SENSOR_CONTROLLER_IMAGE
	bool "Build sensor controller image"
	default y
	help
	  Build a custom sensor controller image that will be automatically
	  included in DFU packages.

config EXTERNAL_MCU_IMAGE
	bool "Build external MCU image"
	default y
	help
	  Build a custom external MCU image that will be automatically
	  included in DFU packages.

# Example: Explicitly enable specific images for DFU (optional)
config DFU_INCLUDE_sensor_controller
	bool "Include sensor controller in DFU"
	depends on SENSOR_CONTROLLER_IMAGE
	default y
	help
	  Explicitly include the sensor controller image in DFU packages.
	  This is optional since the image will be auto-detected if it has
	  CONFIG_DFU_IMAGE_ID or CONFIG_MCUBOOT_IMAGE_NUMBER defined.

config DFU_INCLUDE_external_mcu
	bool "Include external MCU in DFU"
	depends on EXTERNAL_MCU_IMAGE
	default y
	help
	  Explicitly include the external MCU image in DFU packages.
```

## sysbuild/Kconfig.dfu
```kconfig
# Copyright (c) 2023 Nordic Semiconductor
#
# SPDX-License-Identifier: LicenseRef-Nordic-5-Clause

menuconfig DFU_MULTI_IMAGE_PACKAGE_BUILD
	bool "Create multi-image DFU"
	depends on BOOTLOADER_MCUBOOT
	depends on !QSPI_XIP_SPLIT_IMAGE
	help
	  Build DFU Multi Image package that contains a manifest file followed by selected update
	  images.

if DFU_MULTI_IMAGE_PACKAGE_BUILD

config DFU_MULTI_IMAGE_PACKAGE_APP
	bool "Application update"

if SECURE_BOOT

config DFU_MULTI_IMAGE_PACKAGE_NET
	bool "Network core update"
	depends on SUPPORT_NETCORE
	depends on !NETCORE_NONE
	depends on SECURE_BOOT_NETCORE

config DFU_MULTI_IMAGE_PACKAGE_MCUBOOT
	bool "MCUboot update"
	depends on SECURE_BOOT_BUILD_S1_VARIANT_IMAGE

endif # SECURE_BOOT

config DFU_MULTI_IMAGE_PACKAGE_WIFI_FW_PATCH
	bool "nRF70 firmware patch"
	depends on PARTITION_MANAGER
	depends on BOOTLOADER_MCUBOOT
	depends on WIFI_NRF70
	depends on (WIFI_PATCHES_EXT_FLASH_XIP || WIFI_PATCHES_EXT_FLASH_STORE)
	help
	  Enabling this option adds support for Device Firmware Update (DFU) for the nRF70 Series
	  Firmware Patch.

	  This feature requires the addition of an MCUBoot partition pair: a primary and a
	  secondary partition. These partitions are used to store the new firmware patch. The
	  specific partition numbers to be used depend on the number of partitions already in use.

	  The "nrf70_wifi_fw" partition must be added to the newly created MCUBoot primary
	  partition. Once this Kconfig option is enabled, the nRF70.hex file will be signed by
	  MCUBoot. The signed image will then be merged with the application image and flashed onto
	  the target board.

config DFU_MULTI_IMAGE_PACKAGE_CUSTOM_IMAGE
	bool "Custom image update"
	depends on MCUBOOT_CUSTOM_IMAGE_SUPPORT
	help
	  Enable custom image support in multi-image DFU packages.
	  
	  This allows including user-defined custom images in DFU packages
	  alongside standard system images. The custom image will be automatically
	  assigned the next available image number and included in multi-image
	  DFU binaries.

endif # DFU_MULTI_IMAGE_PACKAGE_BUILD
```
