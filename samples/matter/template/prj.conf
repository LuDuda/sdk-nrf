## CMakeLists.txt
```
#
# Copyright (c) 2021 Nordic Semiconductor ASA
#
# SPDX-License-Identifier: LicenseRef-Nordic-5-Clause
#

cmake_minimum_required(VERSION 3.20.0)

# Enable LTO for the project
add_compile_options(-flto)
add_link_options(-flto -fno-ipa-sra -ffunction-sections -fdata-sections)

# Set Kconfig root files that will be processed as a first Kconfig for used child images.
set(mcuboot_KCONFIG_ROOT "\\\${ZEPHYR_CONNECTEDHOMEIP_MODULE_DIR}/config/nrfconnect/chip-module/Kconfig.mcuboot.root")
set(multiprotocol_rpmsg_KCONFIG_ROOT "\\\${ZEPHYR_CONNECTEDHOMEIP_MODULE_DIR}/config/nrfconnect/chip-module/Kconfig.multiprotocol_rpmsg.root")
set(hci_ipc_KCONFIG_ROOT "\\\${ZEPHYR_CONNECTEDHOMEIP_MODULE_DIR}/config/nrfconnect/chip-module/Kconfig.hci_ipc.root")

# For prj.conf the CONF_FILE is empty. In other case extract the exact file name from the path string.
if(CONF_FILE)
    get_filename_component(CONFIG_FILE_NAME ${CONF_FILE} NAME)
endif()

if(NOT "${CONFIG_FILE_NAME}" STREQUAL "prj_no_dfu.conf")
    set(PM_STATIC_YML_FILE ${CMAKE_CURRENT_SOURCE_DIR}/configuration/${BOARD}/pm_static_dfu.yml)
endif()

find_package(Zephyr HINTS $ENV{ZEPHYR_BASE})

project(matter-template)

set(COMMON_ROOT ${ZEPHYR_NRF_MODULE_DIR}/samples/matter/common)
set(NLIO_ROOT ${ZEPHYR_CONNECTEDHOMEIP_MODULE_DIR}/third_party/nlio/repo)
include(${ZEPHYR_CONNECTEDHOMEIP_MODULE_DIR}/config/nrfconnect/app/enable-gnu-std.cmake)
include(${ZEPHYR_CONNECTEDHOMEIP_MODULE_DIR}/src/app/chip_data_model.cmake)

# NORDIC SDK APP START
target_include_directories(app PRIVATE
    src
    ${COMMON_ROOT}/src
    ${NLIO_ROOT}/include
    ${ZEPHYR_CONNECTEDHOMEIP_MODULE_DIR}/zzz_generated/app-common
)

target_sources(app PRIVATE
    src/app_task.cpp
    src/main.cpp
    src/zap-generated/IMClusterCommandHandler.cpp
    src/zap-generated/callback-stub.cpp
    ${COMMON_ROOT}/src/led/led_widget.cpp
    ${COMMON_ROOT}/src/tasks/task_executor.cpp
    ${COMMON_ROOT}/src/board/board.cpp
    ${COMMON_ROOT}/src/init/matter_init.cpp
)

if(CONFIG_CHIP_OTA_REQUESTOR)
    target_sources(app PRIVATE ${COMMON_ROOT}/src/dfu/ota/ota_util.cpp)
endif()

chip_configure_data_model(app
    INCLUDE_SERVER
    BYPASS_IDL
    GEN_DIR src/zap-generated
    ZAP_FILE ${CMAKE_CURRENT_SOURCE_DIR}/src/template.zap
)
# NORDIC SDK APP END
```

## Kconfig.sysbuild
```
#
# Copyright (c) 2024 Nordic Semiconductor
#
# SPDX-License-Identifier: LicenseRef-Nordic-5-Clause
#

config WIFI_NRF70
	default y if BOARD_NRF7002DK

#### Radio core selection
config NRF_DEFAULT_IPC_RADIO
	default y

# Enable IEEE802.15.4 serialization to network core
# This config automatically pulls in the `overlay-802154.conf` in the ipc_radio image
config NETCORE_IPC_RADIO_IEEE802154
	default y if SOC_SERIES_NRF53X && !WIFI_NRF70

# Enable Bluetooth serialization to network core
# This config automatically pulls in the `overlay-bt_hci_ipc.conf` in the ipc_radio image
config NETCORE_IPC_RADIO_BT_HCI_IPC
	default y if SOC_SERIES_NRF53X

#### Bootloader
choice BOOTLOADER
	default BOOTLOADER_MCUBOOT if !BOARD_NRF21540DK
endchoice

if BOOTLOADER_MCUBOOT

#### DFU multi-image support
config DFU_MULTI_IMAGE_PACKAGE_BUILD
	default y

config DFU_MULTI_IMAGE_PACKAGE_APP
	default y

config PM_EXTERNAL_FLASH_MCUBOOT_SECONDARY
	default y

#### DFU network core configuration
if SOC_SERIES_NRF53X

config MCUBOOT_UPDATEABLE_IMAGES
	default 3 if DFU_EXTRA_BINARIES  # app + net + ext_img when extra binaries enabled
	default 2                        # app + net normally

choice MCUBOOT_MODE
	default MCUBOOT_MODE_OVERWRITE_ONLY
endchoice

choice BOOT_SIGNATURE_TYPE
	default BOOT_SIGNATURE_TYPE_RSA
endchoice

config SECURE_BOOT_NETCORE
	default y

config NETCORE_APP_UPDATE
	default y

config DFU_MULTI_IMAGE_PACKAGE_NET
	default y

endif # SOC_SERIES_NRF53X

#### DFU configuration for nRF54L15 (no network core)
if SOC_SERIES_NRF54LX

config MCUBOOT_UPDATEABLE_IMAGES
	default 2 if DFU_EXTRA_BINARIES  # app + ext_img when extra binaries enabled
	default 1                        # app only normally

endif # SOC_SERIES_NRF54LX

if (BOARD_NRF54L15DK || BOARD_NRF54LM20DK)

config PM_OVERRIDE_EXTERNAL_DRIVER_CHECK
	default y

endif # (BOARD_NRF54L15DK || BOARD_NRF54LM20DK)

# Mcuboot padding size is modified to 0x1000 in pm_static file.
if SOC_NRF54L10

config PM_MCUBOOT_PAD
	default 0x1000

endif # SOC_NRF54L10

endif # BOOTLOADER_MCUBOOT

#### Enable generating factory data
config MATTER_FACTORY_DATA_GENERATE
	default y if !BOARD_NRF21540DK

source "share/sysbuild/Kconfig"
```

## sysbuild.conf
```
#
# Copyright (c) 2024 Nordic Semiconductor
#
# SPDX-License-Identifier: LicenseRef-Nordic-5-Clause
#

SB_CONFIG_MATTER=y

SB_CONFIG_MCUBOOT_EXTRA_IMAGES=1
SB_CONFIG_MCUBOOT_UPDATEABLE_IMAGES=3
```

## prj.conf
```kconfig
#
# Copyright (c) 2021 Nordic Semiconductor ASA
#
# SPDX-License-Identifier: LicenseRef-Nordic-5-Clause
#

# This sample uses Kconfig.defaults to set options common for all
# samples. This file should contain only options specific for this sample
# or overrides of default values.

# Enable CHIP
CONFIG_CHIP=y
CONFIG_CHIP_PROJECT_CONFIG="src/chip_project_config.h"
CONFIG_CHIP_DEVICE_PRODUCT_NAME="Matter Template"

# Configure ZAP file name
CONFIG_NCS_SAMPLE_MATTER_ZAP_FILE_PATH="${APPLICATION_CONFIG_DIR}/src/default_zap/template.zap"

# 32768 == 0x8000 (example Product ID added temporaly,
# but it must be changed with proper PID from the list:
# https://github.com/project-chip/connectedhomeip/blob/482e6fd03196a6de45465a90003947ef4b86e0b1/docs/examples/discussion/PID_allocation_for_example_apps.md)
CONFIG_CHIP_DEVICE_PRODUCT_ID=32768
CONFIG_STD_CPP17=y

# Enable Matter pairing automatically on application start.
CONFIG_CHIP_ENABLE_PAIRING_AUTOSTART=y

# Enable Matter extended announcement and increase duration to 1 hour.
CONFIG_CHIP_BLE_EXT_ADVERTISING=y
CONFIG_CHIP_BLE_ADVERTISING_DURATION=60

# Add support for LEDs and buttons on Nordic development kits
CONFIG_DK_LIBRARY=y

# Bluetooth Low Energy configuration
CONFIG_BT_DEVICE_NAME="MatterTemplate"

# Other settings
CONFIG_THREAD_NAME=y
CONFIG_MPU_STACK_GUARD=y
CONFIG_RESET_ON_FATAL_ERROR=n
CONFIG_CHIP_LIB_SHELL=y
CONFIG_NCS_SAMPLE_MATTER_TEST_SHELL=y

# Disable NFC onboarding
CONFIG_CHIP_NFC_ONBOARDING_PAYLOAD=n

# Reduce application size
CONFIG_USE_SEGGER_RTT=n

# Enable Factory Data feature
CONFIG_CHIP_FACTORY_DATA=y
CONFIG_CHIP_FACTORY_DATA_BUILD=y

CONFIG_FLASH=y
CONFIG_FLASH_MAP=y
CONFIG_STREAM_FLASH=y
CONFIG_IMG_MANAGER=y
```

## prj_no_dfu.conf
```kconfig
#
# Copyright (c) 2021 Nordic Semiconductor ASA
#
# SPDX-License-Identifier: LicenseRef-Nordic-5-Clause
#

# This sample uses Kconfig.defaults to set options common for all
# samples. This file should contain only options specific for this sample
# or overrides of default values.

# Enable CHIP
CONFIG_CHIP=y
CONFIG_CHIP_ENABLE_PAIRING_AUTOSTART=y
CONFIG_CHIP_PROJECT_CONFIG="src/chip_project_config.h"
# 32768 == 0x8000 (example Product ID added temporaly,
# but it must be changed with proper PID from the list:
# https://github.com/project-chip/connectedhomeip/blob/482e6fd03196a6de45465a90003947ef4b86e0b1/docs/examples/discussion/PID_allocation_for_example_apps.md)
CONFIG_CHIP_DEVICE_PRODUCT_ID=32768
CONFIG_STD_CPP17=y

# Add support for LEDs and buttons on Nordic development kits
CONFIG_DK_LIBRARY=y

# Bluetooth Low Energy configuration
CONFIG_BT_DEVICE_NAME="MatterTemplate"

# Other settings
CONFIG_THREAD_NAME=y
CONFIG_MPU_STACK_GUARD=y
CONFIG_RESET_ON_FATAL_ERROR=n
CONFIG_CHIP_LIB_SHELL=y

# Disable NFC commissioning
CONFIG_CHIP_NFC_COMMISSIONING=n

# Disable Matter OTA DFU
CONFIG_CHIP_OTA_REQUESTOR=n

# Disable QSPI NOR
CONFIG_CHIP_QSPI_NOR=n

# Reduce application size
CONFIG_USE_SEGGER_RTT=n

# Testing purpose
CONFIG_PSA_CRYPTO_DRIVER_CC3XX=y
CONFIG_PSA_CRYPTO_DRIVER_OBERON=y
CONFIG_PSA_WANT_ALG_SHA_512=y
CONFIG_OPENTHREAD_CRYPTO_PSA_PLATFORM_CONTEXT_ALLOCATION=y
```

## prj_release.conf
```kconfig
#
# Copyright (c) 2021 Nordic Semiconductor ASA
#
# SPDX-License-Identifier: LicenseRef-Nordic-5-Clause
#

# This sample uses Kconfig.defaults to set options common for all
# samples. This file should contain only options specific for this sample
# or overrides of default values.

# Enable CHIP
CONFIG_CHIP=y
CONFIG_CHIP_ENABLE_PAIRING_AUTOSTART=y
CONFIG_CHIP_PROJECT_CONFIG="src/chip_project_config.h"
# 32768 == 0x8000 (example Product ID added temporaly,
# but it must be changed with proper PID from the list:
# https://github.com/project-chip/connectedhomeip/blob/482e6fd03196a6de45465a90003947ef4b86e0b1/docs/examples/discussion/PID_allocation_for_example_apps.md)
CONFIG_CHIP_DEVICE_PRODUCT_ID=32768
CONFIG_STD_CPP17=y

# Add support for LEDs and buttons on Nordic development kits
CONFIG_DK_LIBRARY=y

# Bluetooth Low Energy configuration
CONFIG_BT_DEVICE_NAME="MatterTemplate"

# Enable system reset on fatal error
CONFIG_RESET_ON_FATAL_ERROR=y

# Disable all debug features
CONFIG_USE_SEGGER_RTT=n
CONFIG_SHELL=n
CONFIG_OPENTHREAD_SHELL=n
CONFIG_CONSOLE=n
CONFIG_UART_CONSOLE=n
CONFIG_SERIAL=n
CONFIG_LOG=n
CONFIG_LOG_MODE_MINIMAL=n
CONFIG_ASSERT_VERBOSE=n
CONFIG_ASSERT_NO_FILE_INFO=y
CONFIG_PRINTK=n
CONFIG_PRINTK_SYNC=n
CONFIG_THREAD_NAME=n
CONFIG_BOOT_BANNER=n

# Disable NFC commissioning
CONFIG_CHIP_NFC_COMMISSIONING=n

# Enable Factory Data feature
CONFIG_CHIP_FACTORY_DATA=y
CONFIG_CHIP_FACTORY_DATA_BUILD=y

# Testing purpose
CONFIG_PSA_CRYPTO_DRIVER_CC3XX=y
CONFIG_PSA_CRYPTO_DRIVER_OBERON=y
CONFIG_PSA_WANT_ALG_SHA_512=y
CONFIG_OPENTHREAD_CRYPTO_PSA_PLATFORM_CONTEXT_ALLOCATION=y
```

## sysbuild_ext_img.conf
```kconfig
#
# Copyright (c) 2024 Nordic Semiconductor
#
# SPDX-License-Identifier: LicenseRef-Nordic-5-Clause
#

SB_CONFIG_MATTER=y

# Enable DFU extra binaries support
SB_CONFIG_DFU_EXTRA_BINARIES=y
```

## src/main.cpp
```c
/*
 * Copyright (c) 2021 Nordic Semiconductor ASA
 *
 * SPDX-License-Identifier: LicenseRef-Nordic-5-Clause
 */

#include "app_task.h"

#include <zephyr/logging/log.h>

LOG_MODULE_REGISTER(app, CONFIG_CHIP_APP_LOG_LEVEL);


#include <zephyr/kernel.h>
#include <zephyr/storage/flash_map.h>
#include <pm_config.h>
#include <bootutil/bootutil_public.h>
#include <bootutil/image.h>

static void print_image_content(const char *name, uint32_t img_id,
				uint32_t img_address, uint32_t slot_size)
{
	uint8_t buffer[16];
	const struct flash_area *fa;
	struct image_header hdr;
	uint32_t img_size;
	int ret;

	printk("\n=== %s ===\n", name);
	printk("Slot: 0x%08x (%u bytes)\n", img_address, slot_size);

	ret = flash_area_open(img_id, &fa);
	if (ret != 0) {
		printk("Failed to open flash area\n");
		return;
	}

	ret = boot_image_load_header(fa, &hdr);
	if (ret != 0) {
		printk("No valid MCUboot image found\n");
		flash_area_close(fa);
		return;
	}

	if (hdr.ih_magic != IMAGE_MAGIC) {
		printk("Invalid image magic: 0x%08x\n", hdr.ih_magic);
		flash_area_close(fa);
		return;
	}

	img_size = hdr.ih_img_size;
	printk("Version: %u.%u.%u+%u\n",
	       hdr.ih_ver.iv_major, hdr.ih_ver.iv_minor,
	       hdr.ih_ver.iv_revision, hdr.ih_ver.iv_build_num);
	printk("Image size: %u bytes\n", img_size);
	printk("\nContent (first 512B and last 512B):\n");

	uint32_t bytes_to_show = 512;
	uint32_t offset = hdr.ih_hdr_size;

	if (img_size <= 1024) {
		bytes_to_show = img_size;
	}

	uint32_t sections = (img_size <= 1024) ? 1 : 2;

	for (uint32_t s = 0; s < sections; s++) {
		uint32_t start_offset = offset;
		if (s == 1) {
			start_offset = hdr.ih_hdr_size + img_size - bytes_to_show;
			printk("\n... (skipped middle part) ...\n\n");
		}

		uint32_t bytes_read = 0;

		while (bytes_read < bytes_to_show) {
			uint32_t chunk_size = (bytes_to_show - bytes_read) < sizeof(buffer)
					      ? (bytes_to_show - bytes_read) : sizeof(buffer);

			memset(buffer, 0, sizeof(buffer));
			ret = flash_area_read(fa, start_offset + bytes_read, buffer, chunk_size);
			if (ret != 0) {
				printk("Failed to read flash at 0x%08x\n", start_offset + bytes_read);
				break;
			}

			printk("%06x: ", (start_offset - hdr.ih_hdr_size) + bytes_read);

			for (uint32_t i = 0; i < chunk_size; i++) {
				printk("%02x ", buffer[i]);
			}

			for (uint32_t i = chunk_size; i < 16; i++) {
				printk("   ");
			}

			printk(" |");
			for (uint32_t i = 0; i < chunk_size; i++) {
				char c = buffer[i];
				printk("%c", (c >= 32 && c <= 126) ? c : '.');
			}
			printk("|\n");

			bytes_read += chunk_size;
		}
	}

	flash_area_close(fa);
}

int main(void)
{
	printk("\n*** DFU Extra Images Test ***\n");

	print_image_content("Extra Image primary",
			    PM_MCUBOOT_PRIMARY_2_ID,
			    PM_MCUBOOT_PRIMARY_2_ADDRESS,
			    PM_MCUBOOT_PRIMARY_2_SIZE);

	print_image_content("Extra Image 1 secondary",
			    PM_MCUBOOT_SECONDARY_2_ID,
			    PM_MCUBOOT_SECONDARY_2_ADDRESS,
			    PM_MCUBOOT_SECONDARY_2_SIZE);

	CHIP_ERROR err = AppTask::Instance().StartApp();

	LOG_ERR("Exited with code %" CHIP_ERROR_FORMAT, err.Format());
	return err == CHIP_NO_ERROR ? EXIT_SUCCESS : EXIT_FAILURE;
}
```

## src/app_task.cpp
```c
/*
 * Copyright (c) 2021 Nordic Semiconductor ASA
 *
 * SPDX-License-Identifier: LicenseRef-Nordic-5-Clause
 */

#include "app_task.h"

#include "app/matter_init.h"
#include "app/task_executor.h"
#include "board/board.h"
#include "lib/core/CHIPError.h"
#include "lib/support/CodeUtils.h"

#include <setup_payload/OnboardingCodesUtil.h>

#include <zephyr/logging/log.h>

#include <zephyr/storage/flash_map.h>
#include <zephyr/drivers/flash.h>

LOG_MODULE_DECLARE(app, CONFIG_CHIP_APP_LOG_LEVEL);

using namespace ::chip;
using namespace ::chip::app;
using namespace ::chip::DeviceLayer;

static void PrintExternalImageData()
{
	const struct flash_area *fa;
	int ret = flash_area_open(FLASH_AREA_ID(ext_img), &fa);
	if (ret != 0) {
		LOG_ERR("Failed to open external image partition: %d", ret);
		return;
	}

	uint8_t buffer[512];
	ret = flash_area_read(fa, 0, buffer, sizeof(buffer));
	if (ret != 0) {
		LOG_ERR("Failed to read external image partition: %d", ret);
		flash_area_close(fa);
		return;
	}

	LOG_INF("External image data (first 512 bytes):");
	for (int i = 0; i < 512; i += 16) {
		LOG_INF("%04x: %02x %02x %02x %02x %02x %02x %02x %02x %02x %02x %02x %02x %02x %02x %02x %02x",
			i,
			buffer[i], buffer[i+1], buffer[i+2], buffer[i+3],
			buffer[i+4], buffer[i+5], buffer[i+6], buffer[i+7],
			buffer[i+8], buffer[i+9], buffer[i+10], buffer[i+11],
			buffer[i+12], buffer[i+13], buffer[i+14], buffer[i+15]);
	}

	flash_area_close(fa);
}

CHIP_ERROR AppTask::Init()
{
	/* Initialize Matter stack */
	ReturnErrorOnFailure(Nrf::Matter::PrepareServer());

	if (!Nrf::GetBoard().Init()) {
		LOG_ERR("User interface initialization failed.");
		return CHIP_ERROR_INCORRECT_STATE;
	}

	/* Print external image data on boot */
	PrintExternalImageData();

	/* Register Matter event handler that controls the connectivity status LED based on the captured Matter network
	 * state. */
	ReturnErrorOnFailure(Nrf::Matter::RegisterEventHandler(Nrf::Board::DefaultMatterEventHandler, 0));

	return Nrf::Matter::StartServer();
}

CHIP_ERROR AppTask::StartApp()
{
	ReturnErrorOnFailure(Init());

	while (true) {
		Nrf::DispatchNextTask();
	}

	return CHIP_NO_ERROR;
}
```
